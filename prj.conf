## CMakeLists.txt
```
cmake_minimum_required(VERSION 3.20.0)
set(BOARD atsamd21_xpro)

find_package(Zephyr REQUIRED HINTS $ENV{ZEPHYR_BASE})
project(my_zephyr_app)

target_include_directories(app PRIVATE
    .   
    src
    src/include
)

target_sources(app PRIVATE
    src/main.c
    src/user_button.c
    src/user_led.c
)
```

## prj.conf
```kconfig
# Copyright (c) 2018 Bryan O'Donoghue
# SPDX-License-Identifier: Apache-2.0
CONFIG_SOC_SERIES_SAMD21=y
CONFIG_SOC_PART_NUMBER_SAMD21J18A=y
CONFIG_BOARD_ATSAMD21_XPRO=y
CONFIG_BUILD_OUTPUT_HEX=y
CONFIG_CONSOLE=y
CONFIG_UART_CONSOLE=y
CONFIG_SERIAL=y
CONFIG_UART_INTERRUPT_DRIVEN=y
CONFIG_GPIO=y
CONFIG_SOC_ATMEL_SAMD_XOSC32K=y
CONFIG_SOC_ATMEL_SAMD_XOSC32K_AS_MAIN=y
CONFIG_PWM=y
```

## app.overlay
```dts
// &user_button {
//     debounce-interval-ms = <10>;
// };
```

## src/main.c
```c
#include <zephyr/kernel.h>
#include "user_button.h"
#include "user_led.h"

static int pwm_frequency = 0;


static void button_event_handler(enum button_evt evt)
{
	switch (evt) {
	case BUTTON_EVT_PRESSED:

		return "Pressed";
	case BUTTON_EVT_RELEASED:
		return "Released";
	default:
		return "Unknown";
	}
}

void main(void)
{
	int err = -1;

	printk("Button Debouncing Sample!\n");

	err = button_init(button_event_handler);
	if (err) {
		printk("Button Init failed: %d\n", err);
		return;
	}
	
	err = init_pwm_led();
	if (err) {
		printk("LED Init failed: %d\n", err);
		return;
	}

	printk("Init succeeded. Waiting for event...\n");
}
```

## src/user_button.c
```c
#include <zephyr/kernel.h>
#include <zephyr/drivers/gpio.h>
#include "user_button.h"

#define SW0_NODE	DT_ALIAS(sw0)
#if !DT_NODE_HAS_STATUS(SW0_NODE, okay)
#error "Unsupported board: sw0 devicetree alias is not defined"
#endif

static const struct gpio_dt_spec button = GPIO_DT_SPEC_GET(SW0_NODE, gpios);
static struct gpio_callback button_cb_data;

static button_event_handler_t user_cb;

static void cooldown_expired(struct k_work *work)
{
    ARG_UNUSED(work);

    int val = gpio_pin_get_dt(&button);
    enum button_evt evt = val ? BUTTON_EVT_PRESSED : BUTTON_EVT_RELEASED;
    if (user_cb) {
        user_cb(evt);
    }
}

static K_WORK_DELAYABLE_DEFINE(cooldown_work, cooldown_expired);

void button_pressed(const struct device *dev, struct gpio_callback *cb,
		    uint32_t pins)
{
    k_work_reschedule(&cooldown_work, K_MSEC(500));
}

int button_init(button_event_handler_t handler)
{
    int err = -1;

    if (!handler) {
        return -EINVAL;
    }

    user_cb = handler;

	if (!device_is_ready(button.port)) {
		return -EIO;
	}

	err = gpio_pin_configure_dt(&button, GPIO_INPUT);
	if (err) {
        return err;
	}

	err = gpio_pin_interrupt_configure_dt(&button, GPIO_INT_EDGE_BOTH);
	if (err) {
		return err;
	}

	gpio_init_callback(&button_cb_data, button_pressed, BIT(button.pin));
	err = gpio_add_callback(button.port, &button_cb_data);
    if (err) {
        return err;
    }

    return 0;
}
```

## src/user_led.c
```c
#include <zephyr/drivers/pwm.h>
#include <zephyr/drivers/led.h>
#include "user_led.h"

#define LED_NODE	DT_ALIAS(pwm_led0)
#if !DT_NODE_HAS_STATUS(LED_NODE, okay)
#error "Unsupported board: pwm_led0 devicetree alias is not defined"
#endif

#define MIN_PERIOD PWM_SEC(1U) / 128U
#define MAX_PERIOD PWM_SEC(1U)

const struct pwm_dt_spec pwm_led0 = PWM_DT_SPEC_GET(LED_NODE);


int init_pwm_led(void) {
	uint32_t max_period;
	uint32_t period;
	uint8_t dir = 0U;
	int ret;

    printk("Initializing LED pwm...\n");

	if (!device_is_ready(pwm_led0.dev)) {
		printk("Error: PWM device %s is not ready\n",
		       pwm_led0.dev->name);
		return;
	}

	/*
	 * In case the default MAX_PERIOD value cannot be set for
	 * some PWM hardware, decrease its value until it can.
	 *
	 * Keep its value at least MIN_PERIOD * 4 to make sure
	 * the sample changes frequency at least once.
	 */
	printk("Calibrating for channel %d...\n", pwm_led0.channel);
	max_period = MAX_PERIOD;
	while (pwm_set_dt(&pwm_led0, max_period, max_period / 2U)) {
		max_period /= 2U;
		if (max_period < (4U * MIN_PERIOD)) {
			printk("Error: PWM device "
			       "does not support a period at least %lu\n",
			       4U * MIN_PERIOD);
			return;
		}
	}
	pwm_set_dt(&pwm_led0, 1000000000, 1000000000/2);
}

const struct pwm_dt_spec get_pwm_led_dt(void) {
	return pwm_led0;
}
```
